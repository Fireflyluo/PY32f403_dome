## LIB/rtthread标准板_BSP/py32/libraries/Kconfig
```kconfig
config SOC_FAMILY_PY32
    bool

config SOC_SERIES_PY32F4
    bool
    select ARCH_ARM_CORTEX_M4
    select SOC_FAMILY_PY32

config SOC_PY32F403
    bool
    select SOC_SERIES_PY32F4
```

## demo/rtthread/os/Kconfig
```kconfig
mainmenu "RT-Thread Project Configuration"

config BSP_ROOT
    string
    option env="BSP_ROOT"
    default "."

config RTT_ROOT
    string
    option env="RTT_ROOT"
    default "os/rt-thread"

config PKGS_ROOT
    string
    option env="PKGS_ROOT"
    default "packages"

config SOC_PY32F403C1D
    bool
    select SOC_PY32F403
    select SOC_SERIES_PY32F4
    select SOC_FAMILY_PY32
    select ARCH_ARM
    select ARCH_ARM_CORTEX_M
    select ARCH_ARM_CORTEX_M4
    select RT_USING_COMPONENTS_INIT
    select RT_USING_USER_MAIN
    default y

source "$RTT_ROOT/Kconfig"
source "$PKGS_ROOT/Kconfig"

config SOC_FAMILY_PY32
    bool

config SOC_SERIES_PY32F4
    bool
    select SOC_FAMILY_PY32

config SOC_PY32F403
    bool
    select SOC_SERIES_PY32F4

menu "Hardware Drivers Config"
    config BSP_USING_GPIO
        bool "Enable GPIO"
        select RT_USING_PIN
        default y

    config RT_CONSOLE_DEVICE_NAME
        string "Console device name"
        default "uart2"

    menuconfig BSP_USING_UART
        bool "Enable UART"
        default y
        select RT_USING_SERIAL
        if BSP_USING_UART
            config BSP_USING_UART1
                bool "Enable UART1"
                default y

            config BSP_USING_UART2
                bool "Enable UART2"
                default y

            if BSP_USING_UART2
                config BSP_UART2_RX_USING_DMA
                    bool "UART2 RX DMA"
                    default y

                config BSP_UART2_TX_USING_DMA
                    bool "UART2 TX DMA"
                    default y
            endif
        endif

    menuconfig BSP_USING_SPI
        bool "Enable SPI"
        default y
        select RT_USING_SPI
        if BSP_USING_SPI
            config BSP_USING_SPI1
                bool "Enable SPI1 (W25Q128)"
                default y

            if BSP_USING_SPI1
                config BSP_SPI1_RX_USING_DMA
                    bool "SPI1 RX DMA"
                    default y

                config BSP_SPI1_TX_USING_DMA
                    bool "SPI1 TX DMA"
                    default y
            endif

            config BSP_USING_SPI3
                bool "Enable SPI3 (XN297)"
                default y

            if BSP_USING_SPI3
                config BSP_SPI3_RX_USING_DMA
                    bool "SPI3 RX DMA"
                    default y

                config BSP_SPI3_TX_USING_DMA
                    bool "SPI3 TX DMA"
                    default y
            endif
        endif

    menuconfig BSP_USING_I2C
        bool "Enable I2C"
        default y
        select RT_USING_I2C
        if BSP_USING_I2C
            config BSP_USING_HARD_I2C2
                bool "Enable I2C2"
                default y

            if BSP_USING_HARD_I2C2
                config BSP_I2C2_RX_USING_DMA
                    bool "I2C2 RX DMA"
                    default y

                config BSP_I2C2_TX_USING_DMA
                    bool "I2C2 TX DMA"
                    default y
            endif
        endif

    menuconfig BSP_USING_PWM
        bool "Enable PWM"
        default y
        select RT_USING_PWM
        if BSP_USING_PWM
            config BSP_USING_PWM2
                bool "Enable PWM2"
                default y

            if BSP_USING_PWM2
                config BSP_USING_PWM2_CH2
                    bool "Enable PWM2 CH2 (WS2812)"
                    default y
            endif
        endif

    menuconfig BSP_USING_SFUD
        bool "Enable SPI Flash SFUD"
        default y
        select RT_USING_SFUD
        if BSP_USING_SFUD
            config RT_SFUD_USING_SFDP
                bool "Enable SFDP auto-detect"
                default y

            config RT_SFUD_USING_FLASH_INFO_TABLE
                bool "Enable static flash table fallback"
                default y

            config RT_SFUD_SPI_MAX_HZ
                int "SPI frequency (Hz)"
                range 100000 50000000
                default 50000000
        endif
endmenu
```

## rtthread标准板_BSP/py32/py32f403ahn/dist/xmakeproject/Kconfig
```kconfig
mainmenu "RT-Thread Configuration"

config BSP_DIR
    string
    option env="BSP_ROOT"
    default "."

config RTT_DIR
    string
    option env="RTT_ROOT"
    default "rt-thread"

config PKGS_DIR
    string
    option env="PKGS_ROOT"
    default "packages"

config SOC_PY32F403C1D
    bool
    select SOC_SERIES_PY32F4
    select RT_USING_COMPONENTS_INIT
    select RT_USING_USER_MAIN
    default y

source "$RTT_DIR/Kconfig"
source "$PKGS_DIR/Kconfig"
source "../libraries/Kconfig"

if !RT_USING_NANO
source "board/Kconfig"
endif
```
